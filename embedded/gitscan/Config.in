## embedded/gitscan/Config.in
```kconfig
source "$GH_EXTERNAL_IMAGER_PATH/package/gitscan/Config.in"
source "$GH_EXTERNAL_IMAGER_PATH/package/gitscan-firmware-custom/Config.in"
```

## embedded/gitscan/pickage/gitscan-firmware-custom/Config.in
```kconfig
config GS_PACKAGE_GS_FIRMWARE_CUSTOM
	bool "gitscan-firmware"
	depends on GS_ARM
	help
	  GitScan Firmware
	  Pre-compiled binaries of the current bootloader and GPU firmware

	  https://github.com/w3security/gitscan/firmware

if GS_PACKAGE_GS_FIRMWARE_CUSTOM

choice
	bool "Firmware to boot"
	default GS_PACKAGE_GS_FIRMWARE_CUSTOM_DEFAULT
	help
	  There are three different firmware files:
	    - the default firmware, that enables standard GPU features;
	    - the extended firmware, that enables additional GPU features
	      (eg. more audio/video codecs);
	    - the cut-down firmware, for emergency situations, with only
	      features required to boot a Linux kernel.

config GS_PACKAGE_GS_FIRMWARE_CUSTOM_DEFAULT
	bool "default"
	help
	  The default firmware, that enables standard GPU features.

config GS_PACKAGE_GS_FIRMWARE_CUSTOM_X
	bool "extended ('x', more codecs)"
	help
	  The extended firmware, that enables additional GPU features
	  (eg. more audio/video codecs).

config GS_PACKAGE_GS_FIRMWARE_CUSTOM_CD
	bool "cut-down ('cd', emergency)"
	help
	  The cut-down firmware, for emergency situations, with only
	  features required to boot a Linux kernel.

endchoice

config GS_PACKAGE_GS_FIRMWARE_CUSTOM_BOOT
	string
	default ""      if GS_PACKAGE_GS_FIRMWARE_CUSTOM_DEFAULT
	default "_x"    if GS_PACKAGE_GS_FIRMWARE_CUSTOM_X
	default "_cd"   if GS_PACKAGE_GS_FIRMWARE_CUSTOM_CD

endif # GS_PACKAGE_GS_FIRMWARE_CUSTOM
```

## embedded/gitscan/pickage/gitscan/Config.in
```kconfig
config GS_PACKAGE_GITSCAN_IMAGER
        bool "gitscan"
        select GS_PACKAGE_QT5
        select GS_PACKAGE_QT5BASE_GUI
        select GS_PACKAGE_QT5BASE_CONCURRENT
        select GS_PACKAGE_QT5BASE_JPEG
        select GS_PACKAGE_QT5BASE_PNG
        select GS_PACKAGE_QT5SVG
        select GS_PACKAGE_QT5QUICKCONTROLS2
        select GS_PACKAGE_LIBCURL
        select GS_PACKAGE_LIBARCHIVE
        select GS_PACKAGE_ZSTD        
        select GS_PACKAGE_DOSFSTOOLS
        select GS_PACKAGE_DOSFSTOOLS_MKFS_FAT
        select GS_PACKAGE_OPENSSL
        select GS_PACKAGE_CA_CERTIFICATES
        select GS_PACKAGE_QT5TOOLS
        select GS_PACKAGE_QT5TOOLS_LINGUIST_TOOLS
        
        help
          gitscan Help !
```
